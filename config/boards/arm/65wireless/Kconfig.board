## config/boards/arm/65wireless/Kconfig.board
```kconfig
config BOARD_65WIRELESS
	bool "QBORED 65 Wireless"
	depends on SOC_NRF52840_QIAA
```

## config/boards/arm/QBORED_65W/Kconfig.board
```kconfig
config BOARD_QBORED_65W
	bool "QBORED 65 Wireless"
	depends on SOC_NRF52840_QIAA
```
